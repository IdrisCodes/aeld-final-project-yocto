## build-rpi/conf/bblayers.conf
```bitbake
# POKY_BBLAYERS_CONF_VERSION is increased each time build/conf/bblayers.conf
# changes incompatibly
POKY_BBLAYERS_CONF_VERSION = "2"

BBPATH = "${TOPDIR}"
BBFILES ?= ""

BBLAYERS ?= " \
  /home/idris/Projects/Coursera/EmbeddedLinux/Course3/yocto-project/poky/meta \
  /home/idris/Projects/Coursera/EmbeddedLinux/Course3/yocto-project/poky/meta-poky \
  /home/idris/Projects/Coursera/EmbeddedLinux/Course3/yocto-project/poky/meta-yocto-bsp \
  /home/idris/Projects/Coursera/EmbeddedLinux/Course3/yocto-project/meta-openembedded/meta-oe \
  /home/idris/Projects/Coursera/EmbeddedLinux/Course3/yocto-project/meta-openembedded/meta-python \
  /home/idris/Projects/Coursera/EmbeddedLinux/Course3/yocto-project/meta-openembedded/meta-networking \
  /home/idris/Projects/Coursera/EmbeddedLinux/Course3/yocto-project/meta-openembedded/meta-multimedia \
  /home/idris/Projects/Coursera/EmbeddedLinux/Course3/yocto-project/meta-raspberrypi \
  /home/idris/Projects/Coursera/EmbeddedLinux/Course3/yocto-project/meta-qt6 \
  /home/idris/Projects/Coursera/EmbeddedLinux/Course3/yocto-project/build-rpi/workspace \
  "
```
